## main/Kconfig.projbuild
```kconfig
menu "NRF24 Configuration"

    choice NRF24_PROJECT_MODE
        prompt "Project mode"
        default NRF24_MODE_TUTORIAL_DEBUG

        config NRF24_MODE_TUTORIAL_DEBUG
            bool "Tutorial Debug (teaching + diagnostics)"

        config NRF24_MODE_RELEASE_LITE
            bool "Release Lite (minimal logs + simple config)"
    endchoice

    choice NRF24_APP_ROLE
        prompt "Application role"
        default NRF24_ROLE_TX

        config NRF24_ROLE_TX
            bool "TX role (periodic sender)"
        config NRF24_ROLE_RX
            bool "RX role (listener)"
    endchoice

    config NRF24_SPI_HOST
        int "SPI host (2=SPI2_HOST, 3=SPI3_HOST)"
        range 2 3
        default 2

    config NRF24_PIN_MOSI
        int "MOSI GPIO"
        default 13

    config NRF24_PIN_MISO
        int "MISO GPIO"
        default 12

    config NRF24_PIN_SCK
        int "SCK GPIO"
        default 14

    config NRF24_PIN_CSN
        int "CSN GPIO"
        default 11

    config NRF24_PIN_CE
        int "CE GPIO"
        default 10

    config NRF24_PIN_IRQ
        int "IRQ GPIO"
        default 3

    config NRF24_CHANNEL
        int "RF channel (0-125)"
        range 0 125
        default 40

    config NRF24_PAYLOAD_SIZE
        int "Static payload size (bytes)"
        range 1 32
        default 32

    choice NRF24_DATA_RATE
        prompt "Air data rate"
        default NRF24_DATA_RATE_1M

        config NRF24_DATA_RATE_1M
            bool "1 Mbps"
        config NRF24_DATA_RATE_2M
            bool "2 Mbps"
        config NRF24_DATA_RATE_250K
            bool "250 Kbps"
    endchoice

    choice NRF24_PA_LEVEL
        prompt "TX power level"
        default NRF24_PA_12DBM if NRF24_MODE_TUTORIAL_DEBUG
        default NRF24_PA_0DBM if NRF24_MODE_RELEASE_LITE

        config NRF24_PA_18DBM
            bool "-18 dBm"
        config NRF24_PA_12DBM
            bool "-12 dBm"
        config NRF24_PA_6DBM
            bool "-6 dBm"
        config NRF24_PA_0DBM
            bool "0 dBm"
    endchoice

    config NRF24_ADDR_WIDTH
        int "Address width (bytes)"
        range 3 5
        default 5

    config NRF24_PIPE0_ADDR
        string "Pipe0 address (hex, no 0x, e.g. E7E7E7E7E7)"
        default "E7E7E7E7E7"

    config NRF24_PIPE1_ADDR
        string "Pipe1 address (hex, no 0x, e.g. C2C2C2C2C2)"
        default "C2C2C2C2C2"
        depends on NRF24_MODE_TUTORIAL_DEBUG

    config NRF24_TX_ADDR
        string "TX address (hex, no 0x)"
        default "E7E7E7E7E7"

    config NRF24_ENABLE_PIPE1
        bool "Enable RX pipe1"
        default y
        depends on NRF24_MODE_TUTORIAL_DEBUG

    config NRF24_AUTO_RETR_DELAY_US
        int "Auto retransmit delay (us, step 250)"
        range 250 4000
        default 750
        depends on NRF24_MODE_TUTORIAL_DEBUG

    config NRF24_AUTO_RETR_COUNT
        int "Auto retransmit count"
        range 0 15
        default 10
        depends on NRF24_MODE_TUTORIAL_DEBUG

    config NRF24_TX_PERIOD_MS
        int "TX task period (ms)"
        range 10 60000
        default 1000

    config NRF24_TX_POWER_SAVE
        bool "Power down between TX cycles"
        default y
        depends on NRF24_MODE_TUTORIAL_DEBUG

    config NRF24_TX_DISABLE_AUTO_ACK_TEST
        bool "TX test: disable auto-ack"
        default n
        depends on NRF24_MODE_TUTORIAL_DEBUG
        help
            Disable auto-ack on TX side for link bring-up diagnostics.
            If this makes packets appear on RX, then ACK path is the blocker.

    config NRF24_PIN_TEST_MODE
        bool "Enable pin self-test mode"
        default n
        depends on NRF24_MODE_TUTORIAL_DEBUG
        help
            Run GPIO self-test only. The app will not start normal NRF24 TX/RX flow.
            CE/CSN are toggled periodically and pin states are logged.

    config NRF24_PIN_TEST_PERIOD_MS
        int "Pin self-test toggle period (ms)"
        range 100 5000
        default 500
        depends on NRF24_PIN_TEST_MODE

    config NRF24_LOG_LEVEL_VERBOSE
        bool "Verbose driver logging"
        default y if NRF24_MODE_TUTORIAL_DEBUG
        default n if NRF24_MODE_RELEASE_LITE

    config NRF24_CONTROL_WIFI_ENABLE
        bool "Enable wireless control service"
        default y
        help
            Start a SoftAP and TCP command service for wireless upper computer control.

    config NRF24_CONTROL_WIFI_RX_SSID
        string "RX wireless control AP SSID"
        default "NRF24_RX"
        depends on NRF24_CONTROL_WIFI_ENABLE && NRF24_ROLE_RX

    config NRF24_CONTROL_WIFI_TX_PREFIX
        string "TX wireless control AP prefix"
        default "NRF24_TX"
        depends on NRF24_CONTROL_WIFI_ENABLE && NRF24_ROLE_TX

    config NRF24_CONTROL_WIFI_TX_ID
        int "TX wireless control AP index"
        range 1 99
        default 1
        depends on NRF24_CONTROL_WIFI_ENABLE && NRF24_ROLE_TX

    config NRF24_CONTROL_WIFI_SSID
        string "Wireless control AP SSID"
        default "NRF24_CTRL"
        depends on NRF24_CONTROL_WIFI_ENABLE

    config NRF24_CONTROL_WIFI_PASSWORD
        string "Wireless control AP password"
        default "nrf24ctrl"
        depends on NRF24_CONTROL_WIFI_ENABLE
        help
            Must be at least 8 characters for WPA2.

    config NRF24_CONTROL_TCP_PORT
        int "Wireless control TCP port"
        range 1 65535
        default 3333
        depends on NRF24_CONTROL_WIFI_ENABLE

    config NRF24_CONTROL_TOKEN
        string "Wireless control token"
        default "nrf24"
        depends on NRF24_CONTROL_WIFI_ENABLE

endmenu
```

## sdkconfig.defaults
```kconfig
CONFIG_ESPTOOLPY_FLASHMODE_QIO=y
CONFIG_ESPTOOLPY_FLASHFREQ_80M=y
CONFIG_ESPTOOLPY_FLASHSIZE_8MB=y
CONFIG_PARTITION_TABLE_CUSTOM=y
CONFIG_PARTITION_TABLE_CUSTOM_FILENAME="partitions.csv"

CONFIG_ESP_CONSOLE_UART_BAUDRATE=115200

CONFIG_FREERTOS_HZ=1000
CONFIG_FREERTOS_UNICORE=n
CONFIG_FREERTOS_USE_TICKLESS_IDLE=y

CONFIG_LOG_DEFAULT_LEVEL_INFO=y
CONFIG_LOG_MAXIMUM_LEVEL=3
CONFIG_LOG_MASTER_LEVEL=y

CONFIG_COMPILER_OPTIMIZATION_SIZE=y
CONFIG_ESP_DEFAULT_CPU_FREQ_MHZ_240=y
CONFIG_ESP_SYSTEM_PANIC_PRINT_REBOOT=y

CONFIG_NRF24_MODE_TUTORIAL_DEBUG=y
# CONFIG_NRF24_MODE_RELEASE_LITE is not set

CONFIG_NRF24_ROLE_TX=y
CONFIG_NRF24_SPI_HOST=2
CONFIG_NRF24_PIN_MOSI=13
CONFIG_NRF24_PIN_MISO=12
CONFIG_NRF24_PIN_SCK=14
CONFIG_NRF24_PIN_CSN=11
CONFIG_NRF24_PIN_CE=10
CONFIG_NRF24_PIN_IRQ=3
CONFIG_NRF24_CHANNEL=40
CONFIG_NRF24_PAYLOAD_SIZE=32
CONFIG_NRF24_DATA_RATE_250K=y
CONFIG_NRF24_PA_12DBM=y
CONFIG_NRF24_ADDR_WIDTH=5
CONFIG_NRF24_PIPE0_ADDR="E7E7E7E7E7"
CONFIG_NRF24_PIPE1_ADDR="C2C2C2C2C2"
CONFIG_NRF24_TX_ADDR="E7E7E7E7E7"
CONFIG_NRF24_ENABLE_PIPE1=y
CONFIG_NRF24_AUTO_RETR_DELAY_US=750
CONFIG_NRF24_AUTO_RETR_COUNT=10
CONFIG_NRF24_TX_PERIOD_MS=1000
CONFIG_NRF24_TX_POWER_SAVE=y
CONFIG_NRF24_LOG_LEVEL_VERBOSE=y
```

## sdkconfig.defaults.esp32
```kconfig
CONFIG_NRF24_SPI_HOST=2
CONFIG_NRF24_PIN_MOSI=23
CONFIG_NRF24_PIN_MISO=19
CONFIG_NRF24_PIN_SCK=18
CONFIG_NRF24_PIN_CSN=5
CONFIG_NRF24_PIN_CE=17
CONFIG_NRF24_PIN_IRQ=16
```

## sdkconfig.defaults.esp32s3
```kconfig
CONFIG_NRF24_PIN_MOSI=13
CONFIG_NRF24_PIN_MISO=12
CONFIG_NRF24_PIN_SCK=14
CONFIG_NRF24_PIN_CSN=11
CONFIG_NRF24_PIN_CE=10
CONFIG_NRF24_PIN_IRQ=3
```

## sdkconfig.defaults.tutorial
```kconfig
# Tutorial Debug profile: richer logs and diagnostics for learning.
CONFIG_NRF24_MODE_TUTORIAL_DEBUG=y
# CONFIG_NRF24_MODE_RELEASE_LITE is not set

CONFIG_NRF24_ROLE_TX=y
# CONFIG_NRF24_ROLE_RX is not set

CONFIG_NRF24_SPI_HOST=2
CONFIG_NRF24_PIN_MOSI=13
CONFIG_NRF24_PIN_MISO=12
CONFIG_NRF24_PIN_SCK=14
CONFIG_NRF24_PIN_CSN=11
CONFIG_NRF24_PIN_CE=10
CONFIG_NRF24_PIN_IRQ=3

CONFIG_NRF24_CHANNEL=40
CONFIG_NRF24_PAYLOAD_SIZE=32
CONFIG_NRF24_DATA_RATE_250K=y
# CONFIG_NRF24_DATA_RATE_1M is not set
# CONFIG_NRF24_DATA_RATE_2M is not set
CONFIG_NRF24_PA_12DBM=y
# CONFIG_NRF24_PA_18DBM is not set
# CONFIG_NRF24_PA_6DBM is not set
# CONFIG_NRF24_PA_0DBM is not set

CONFIG_NRF24_ADDR_WIDTH=5
CONFIG_NRF24_PIPE0_ADDR="E7E7E7E7E7"
CONFIG_NRF24_PIPE1_ADDR="C2C2C2C2C2"
CONFIG_NRF24_TX_ADDR="E7E7E7E7E7"
CONFIG_NRF24_ENABLE_PIPE1=y

CONFIG_NRF24_AUTO_RETR_DELAY_US=750
CONFIG_NRF24_AUTO_RETR_COUNT=10
CONFIG_NRF24_TX_PERIOD_MS=1000
CONFIG_NRF24_TX_POWER_SAVE=y
# CONFIG_NRF24_TX_DISABLE_AUTO_ACK_TEST is not set
# CONFIG_NRF24_PIN_TEST_MODE is not set
CONFIG_NRF24_PIN_TEST_PERIOD_MS=500
CONFIG_NRF24_LOG_LEVEL_VERBOSE=y
```
